## conf/layer.conf
```bitbake
# We have a conf and classes directory, append to BBPATH
BBPATH .= ":${LAYERDIR}"

# We have a recipes directory, add to BBFILES
BBFILES += "${LAYERDIR}/recipes*/*/*.bb ${LAYERDIR}/recipes*/*/*.bbappend"

BBFILE_COLLECTIONS += "unify-layer"
BBFILE_PATTERN_unify-layer := "^${LAYERDIR}/"
BBFILE_PRIORITY_unify-layer = "8"

# This should only be incremented on significant changes that will
# cause compatibility issues with other layers
LAYERVERSION_unify-layer = "1"

LAYERDEPENDS_unify-layer = "caros core networking-layer"
```
